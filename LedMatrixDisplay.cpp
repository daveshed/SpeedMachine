#include "Arduino.h"
#include "LedMatrixDisplay.h"

byte LedMatrixDisplay::font[95][8] = {
    {0,0,0,0,0,0,0,0}, // SPACE
    {0x10,0x18,0x18,0x18,0x18,0x00,0x18,0x18}, // EXCL
    {0x28,0x28,0x08,0x00,0x00,0x00,0x00,0x00}, // QUOT
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    {0x00,0x7c,0x04,0x08,0x7c,0x20,0x40,0xfe}, // Z
};    // {}, //

LedMatrixDisplay::LedMatrixDisplay(uint8_t segments, uint8_t csPin)
    : display(segments, csPin) {}

void LedMatrixDisplay::setup(void)
{
    display.setEnabled(true);
    display.setIntensity(2);   // 0 = low, 10 = high
    display.clear();
}

void LedMatrixDisplay::clear(void)
{
    display.clear();
}

void LedMatrixDisplay::showDecimal(double decimal, uint8_t precision)
{
    String toDisplay = String((decimal), precision);
    drawString(toDisplay);
}

void LedMatrixDisplay::drawString(String& toDraw)
{
    int xOffset = 0;
    int yOffset = 0;
    char text[LEDMATRIX_SEGMENTS] = {'\0'};
    int len = toDraw.length();
    toDraw.toCharArray(text, (toDraw.length() + 1));
    for( int idx = 0; idx < len; idx ++ )
    {
        int c = text[idx] - 32;
        // stop if char is outside visible area
        if( xOffset + idx * 8  > LEDMATRIX_WIDTH ) return;
        // only draw if char is visible
        if( 8 + xOffset + idx * 8 > 0 ) drawSprite(
            font[c], xOffset + idx * 8, yOffset, 8, 8 );
    }
}

byte a[8]={ B00011000,
            B00100100,
            B00100100,
            B00011000,
            B01111110,
            B00011000,
            B00100100,
            B01000010};

byte b[8]={ B00011000,
            B00100100,
            B00100100,
            B00011010,
            B01111100,
            B00011000,
            B01100100,
            B00000010};

byte c[8]={ B00011000,
            B00100100,
            B00100100,
            B00011010,
            B00111100,
            B01011000,
            B00110100,
            B00000100};

byte d[8]={ B00011000,
            B00100100,
            B00100100,
            B00011010,
            B00111100,
            B01011000,
            B00011000,
            B00011000};

byte e[8]={ B00011000,
            B00100100,
            B00100100,
            B00011010,
            B00111100,
            B01011000,
            B00010100,
            B00010000};

byte f[8]={ B00011000,
            B00100100,
            B00100100,
            B00011000,
            B00111110,
            B01011000,
            B00010100,
            B00010100};


void LedMatrixDisplay::doAnimation(void)
{
    const int ANIM_DELAY = 100;
    int x = 0;
    while (x < LEDMATRIX_WIDTH)
    {
        drawSprite( (byte*)&a, x++, 0, 8, 8 );
        display.display();
        delay(ANIM_DELAY);

        display.clear();
        drawSprite( (byte*)&b, x++, 0, 8, 8 );
        display.display();
        delay(ANIM_DELAY);

        display.clear();
        drawSprite( (byte*)&c, x++, 0, 8, 8 );
        display.display();
        delay(ANIM_DELAY);

        display.clear();
        drawSprite( (byte*)&d, x++, 0, 8, 8 );
        display.display();
        delay(ANIM_DELAY);

        display.clear();
        drawSprite( (byte*)&e, x++, 0, 8, 8 );
        display.display();
        delay(ANIM_DELAY);

        display.clear();
        drawSprite( (byte*)&f, x++, 0, 8, 8 );
        display.display();
        delay(ANIM_DELAY);
    }
}

void LedMatrixDisplay::drawSprite( byte* sprite, int x, int y, int width, int height )
{
    // The mask is used to get the column bit from the sprite row
    byte mask = B10000000;

    for( int iy = 0; iy < height; iy++ )
    {
        for( int ix = 0; ix < width; ix++ )
        {
            display.setPixel(x + ix, y + iy, (bool)(sprite[iy] & mask ));
            // shift the mask by one pixel to the right
            mask = mask >> 1;
        }
        // reset column mask
        mask = B10000000;
    }
    display.display();
}
